## kernel-2.6.39-1.ce22.t1.src/thecus_drv_board/thecus_drv_board/src/event/Kconfig
```kconfig
#
# Thecus device drivers
#
# *** DEPRECATED! Do not add new entries! See Makefile ***
#

menu "Thecus Event support"

config THECUS_EVENT
	bool "Thecus Event from proc"
	default y
	help
	  If you say yes here you get support for Thecus event in proc entry.
	  The event will be shown by /proc/thecus_eventc

endmenu
```

## kernel-2.6.39-1.ce22.t1.src/thecus_drv_board/thecus_drv_board/src/gpio/Kconfig
```kconfig
#
# Miscellaneous I2C chip drivers configuration
#
# *** DEPRECATED! Do not add new entries! See Makefile ***
#

menu "Miscellaneous Thecus Chip support"

config THECUS_BOARD
	bool "Thecus Board I/O Device"
	default y
	help
	  If you say yes here you get support for Thecus board device.

config THECUS_PCA9532
	bool "Thecus PCA9532 GPIO Device"
	depends on I2C && EXPERIMENTAL
	help
	  If you say yes here you get support for Thecus pca9532 device.

config THECUS_N16000_IO
	tristate "Thecus N16000 MB I/O operation"
	depends on THECUS_EVENT && THECUS_BOARD
	select THECUS_PCA9532
	help
	  If you say yes here you get support for the
	  Thecus N16000 MB io operation.

	  This driver can also be built as a module. If so, the module
	  will be called n16000_io.

config THECUS_N8900_IO
	tristate "Thecus N8900 MB I/O operation"
	depends on THECUS_EVENT && THECUS_BOARD
	select THECUS_PCA9532
	help
	  If you say yes here you get support for the
	  Thecus N8900 MB io operation.

	  This driver can also be built as a module. If so, the module
	  will be called n8900_io.

config THECUS_N2800_IO
	tristate "Thecus N2800 MB I/O operation"
	depends on THECUS_EVENT && THECUS_BOARD
	select THECUS_PCA9532
	help
	  If you say yes here you get support for the
	  Thecus N2800 MB io operation.

	  This driver can also be built as a module. If so, the module
	  will be called n2800_io.

config THECUS_N7700PRO_IO
	tristate "Thecus N7700PRO MB I/O operation"
	depends on THECUS_EVENT && THECUS_BOARD
	select THECUS_PCA9532
	help
	  If you say yes here you get support for the
	  Thecus N7700PRO MB io operation.

	  This driver can also be built as a module. If so, the module
	  will be called n7700pro_io.

config THECUS_N2520_IO
	tristate "Thecus N2520 MB I/O operation"
	depends on THECUS_EVENT && THECUS_BOARD && THECUS_PICUART_GPIO && ARCH_GEN3
	select THECUS_PCA9532
	help
	  If you say yes here you get support for the
	  Thecus N2520 MB io operation.

	  This driver can also be built as a module. If so, the module
	  will be called n2520_io.

config THECUS_PICUART_GPIO
	tristate "Thecus PICUART GPIO operation"
	depends on ARCH_GEN3
	help
	  If you say yes here you get support for the
	  Thecus PICUART GPIO operation.

	  This driver can also be built as a module. If so, the module
	  will be called picuart_gpio.

config THECUS_PIC24
	tristate "Thecus PIC24 operation"
	depends on ARCH_GEN3
	help
	  If you say yes here you get support for the
	  Thecus PICUART GPIO operation.

	  This driver can also be built as a module. If so, the module
	  will be called picuart_gpio.

config THECUS_N2310_IO
	tristate "Thecus N2310 MB I/O operation"
	depends on THECUS_EVENT && THECUS_BOARD
	help
	  If you say yes here you get support for the
	  Thecus N2310 MB io operation.

	  This driver can also be built as a module. If so, the module
	  will be called n2310_io.

endmenu
```

## kernel-2.6.39-1.ce23.t1.src/thecus_drv_board/thecus_drv_board/src/Kconfig
```kconfig
#
# Thecus device drivers
#
# *** DEPRECATED! Do not add new entries! See Makefile ***
#

menuconfig THECUS
	bool "Thecus Device Support"
	default y
	---help---
	  Thecus device driver includes board GPIO control, HW monitor and
	  event handler for Thecus boards.

	  If you want Thecus support, you should say Y here and also to the
	  specific driver for your Thecus model below.

if THECUS

source drivers/thecus/event/Kconfig
source drivers/thecus/gpio/Kconfig
source drivers/thecus/hwmon/Kconfig

endif #THECUS
```

## kernel-2.6.39-1.ce23.t1.src/thecus_drv_board/thecus_drv_board/src/hwmon/Kconfig
```kconfig
#
# Hardware monitoring chip drivers configuration
#
menu "Miscellaneous Thecus Hardware Monitor support"

config THECUS_SENSORS_F71882FG
	tristate "Fintek F71858FG, F71862FG, F71882FG, F71889FG and F8000"
	help
	  If you say yes here you get support for hardware monitoring
	  features of the Fintek F71858FG, F71862FG/71863FG, F71882FG/F71883FG,
	  F71889FG and F8000 Super-I/O chips.

	  This driver can also be built as a module.  If so, the module
	  will be called f71882fg.

config THECUS_SENSORS_F75375S
	tristate "Fintek F75375S/SP, F75373 and F75387SG"
	depends on I2C
	help
	  If you say yes here you get support for hardware monitoring
	  features of the Fintek F75375S/SP, F75373 and F75387SG.

	  This driver can also be built as a module.  If so, the module
	  will be called f75375s.

config THECUS_SENSORS_IT87
	tristate "ITE IT87xx and compatibles"
	select HWMON_VID
	help
	  If you say yes here you get support for ITE IT8705F, IT8712F,
	  IT8716F, IT8718F, IT8720F, IT8721F, IT8726F and IT8758E sensor
	  chips, and the SiS960 clone.

	  This driver can also be built as a module.  If so, the module
	  will be called it87.

config THECUS_SENSORS_W83795
	tristate "Winbond/Nuvoton W83795G/ADG"
	depends on I2C && EXPERIMENTAL
	help
	  If you say yes here you get support for the Winbond W83795G and
	  W83795ADG hardware monitoring chip.

	  This driver can also be built as a module.  If so, the module
	  will be called w83795.

config THECUS_SENSORS_W83627EHF
	tristate "Winbond W83627EHF/EHG/DHG, W83667HG"
	select HWMON_VID
	help
	  If you say yes here you get support for the hardware
	  monitoring functionality of the Winbond W83627EHF Super-I/O chip.

	  This driver also supports the W83627EHG, which is the lead-free
	  version of the W83627EHF, and the W83627DHG, which is a similar
	  chip suited for specific Intel processors that use PECI such as
	  the Core 2 Duo.

	  This driver also supports the W83667HG chip.

	  This driver can also be built as a module.  If so, the module
	  will be called w83627ehf.

config THECUS_SENSORS_TMP401
	tristate "Texas Instruments TMP401 and compatibles"
	depends on I2C && EXPERIMENTAL
	help
	  If you say yes here you get support for Texas Instruments TMP401 and
	  TMP411 temperature sensor chips.

	  This driver can also be built as a module.  If so, the module
	  will be called tmp401.
endmenu
```
